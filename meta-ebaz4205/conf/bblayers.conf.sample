## meta-ebaz4205/conf/bblayers.conf.sample
```bitbake
# POKY_BBLAYERS_CONF_VERSION is increased each time build/conf/bblayers.conf
# changes incompatibly
POKY_BBLAYERS_CONF_VERSION = "2"

BBPATH = "${TOPDIR}"
BBFILES = ""

BBLAYERS = " \
  ##OEROOT##/meta \
  ##OEROOT##/meta-poky \
  ##OEROOT##/meta-yocto-bsp \
  ##OEROOT##/../meta-openembedded/meta-oe \
  ##OEROOT##/../meta-openembedded/meta-python \
  ##OEROOT##/../meta-openembedded/meta-networking \
  ##OEROOT##/../meta-xilinx/meta-xilinx-bsp \
  ##OEROOT##/../meta-xilinx/meta-xilinx-standalone \
  ##OEROOT##/../meta-xilinx/meta-xilinx-standalone-experimental \
  ##OEROOT##/../meta-xilinx/meta-microblaze \
  ##OEROOT##/../meta-ebaz4205 \
  "
```

## meta-ebaz4205/conf/distro/ebaz4205.conf
```bitbake
DISTRO = "ebaz4205"
DISTRO_NAME = "distro for ebaz4205"
DISTRO_FEATURES_append = " systemd"

DISTRO_FEATURES_BACKFILL_CONSIDERED = "sysvinit"
VIRTUAL-RUNTIME_init_manager = "systemd"
VIRTUAL-RUNTIME_initscripts = "systemd-compat-units"
```

## meta-ebaz4205/conf/layer.conf
```bitbake
# We have a conf and classes directory, add to BBPATH
BBPATH .= ":${LAYERDIR}"

# We have recipes-* directories, add to BBFILES
BBFILES += "${LAYERDIR}/recipes-*/*/*.bb \
            ${LAYERDIR}/recipes-*/*/*.bbappend"

BBFILE_COLLECTIONS += "meta-ebaz4205"
BBFILE_PATTERN_meta-ebaz4205 = "^${LAYERDIR}/"
BBFILE_PRIORITY_meta-ebaz4205 = "6"

LAYERDEPENDS_meta-ebaz4205 = "core xilinx openembedded-layer networking-layer"
LAYERSERIES_COMPAT_meta-ebaz4205 = "gatesgarth"
```

## meta-ebaz4205/conf/machine/ebaz4205-zynq7.conf
```bitbake
#@TYPE: Machine
#@NAME: ebaz4205-zynq7
#@DESCRIPTION: Machine support for EBAZ4205

SOC_VARIANT ?= "7z"

require conf/machine/include/soc-zynq.inc
require conf/machine/include/machine-xilinx-default.inc

MACHINE_FEATURES = "ext2 vfat"

# u-boot configuration
PREFERRED_PROVIDER_virtual/bootloader = "u-boot"
UBOOT_MACHINE = "zynq_ebaz4205_config"
UBOOT_SUFFIX = "bin"
UBOOT_ELF = ""

KERNEL_IMAGETYPES  = "${KERNEL_IMAGETYPE}"

EXTRA_IMAGEDEPENDS += " \
		virtual/bootloader \
		"

SERIAL_CONSOLE = "115200 ttyPS0"
SERIAL_CONSOLES_CHECK = "${SERIAL_CONSOLES}"

MACHINE_ESSENTIAL_EXTRA_RDEPENDS += "device-tree"
```
